## firmware/walkie-talkie/sdkconfig.defaults
```kconfig
# FreeRTOS
CONFIG_FREERTOS_HZ=1000

# ESP-NOW / Wi-Fi
CONFIG_ESP_WIFI_STATIC_RX_BUFFER_NUM=16
CONFIG_ESP_WIFI_DYNAMIC_RX_BUFFER_NUM=32
CONFIG_ESP_WIFI_STATIC_TX_BUFFER=y
CONFIG_ESP_WIFI_TX_BUFFER_TYPE=0
CONFIG_ESP_WIFI_STATIC_TX_BUFFER_NUM=16
CONFIG_ESP_WIFI_AMPDU_TX_ENABLED=n
CONFIG_ESP_WIFI_AMPDU_RX_ENABLED=n

# Common Flash Configuration
CONFIG_ESPTOOLPY_FLASHSIZE_4MB=y

# Log output
CONFIG_LOG_DEFAULT_LEVEL_INFO=y
```
